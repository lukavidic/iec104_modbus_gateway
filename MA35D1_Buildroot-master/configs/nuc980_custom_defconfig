## MA35D1_Buildroot-master/configs/nuc980_custom_defconfig
```kconfig
BR2_arm=y
BR2_SVN="svn"
BR2_STRIP_EXCLUDE_FILES="liblib60870.a"
BR2_SHARED_STATIC_LIBS=y
BR2_TOOLCHAIN_BUILDROOT_VENDOR="nuvoton"
BR2_TOOLCHAIN_BUILDROOT_LOCALE=y
BR2_TOOLCHAIN_BUILDROOT_CXX=y
BR2_PACKAGE_HOST_GDB=y
BR2_ROOTFS_DEVICE_CREATION_DYNAMIC_MDEV=y
BR2_TARGET_GENERIC_GETTY_BAUDRATE_115200=y
BR2_ROOTFS_OVERLAY="board/nuvoton/nuc9x0/overlay/"
BR2_ROOTFS_POST_BUILD_SCRIPT="board/nuvoton/nuc9x0/install_nuc980_iot.sh"
BR2_ROOTFS_POST_IMAGE_SCRIPT="board/nuvoton/nuc9x0/install_tftp_files.sh"
BR2_LINUX_KERNEL=y
BR2_LINUX_KERNEL_CUSTOM_TARBALL=y
BR2_LINUX_KERNEL_CUSTOM_TARBALL_LOCATION="$(call github,OpenNuvoton,NUC980-linux-5.10.y,master)/NUC980-linux-5.10.y-master.tar.gz"
BR2_LINUX_KERNEL_PATCH="board/nuvoton/nuc9x0/kernel_files/patch-5.10.140-rt73.patch"
BR2_LINUX_KERNEL_USE_CUSTOM_CONFIG=y
BR2_LINUX_KERNEL_CUSTOM_CONFIG_FILE="board/nuvoton/nuc9x0/kernel_files/linux_config"
BR2_LINUX_KERNEL_UIMAGE=y
BR2_LINUX_KERNEL_DTS_SUPPORT=y
BR2_LINUX_KERNEL_CUSTOM_DTS_PATH="board/nuvoton/nuc9x0/kernel_files/nuc980-custom.dts"
BR2_PACKAGE_LINUX_TOOLS_GPIO=y
BR2_PACKAGE_LINUX_TOOLS_IIO=y
BR2_PACKAGE_APPLICATIONS=y
NUC980_APPLICATIONS=y
NUC980_APPLICATIONS_BUILD_DEMOS=y
NUC980_APPLICATIONS_BUILD_YAFFS2UTILS=y
BR2_PACKAGE_ALSA_UTILS=y
BR2_PACKAGE_ALSA_UTILS_IECSET=y
BR2_PACKAGE_BZIP2=y
BR2_PACKAGE_ZIP=y
BR2_PACKAGE_GETTEXT=y
BR2_PACKAGE_LIBIEC61850=y
BR2_PACKAGE_RS485CONF=y
BR2_PACKAGE_LIBAIO=y
BR2_PACKAGE_JANSSON=y
BR2_PACKAGE_LIBMODBUS=y
BR2_PACKAGE_OPENSSH=y
BR2_TARGET_ROOTFS_INITRAMFS=y
BR2_TARGET_UBOOT=y
BR2_TARGET_UBOOT_BUILD_SYSTEM_KCONFIG=y
BR2_TARGET_UBOOT_CUSTOM_TARBALL=y
BR2_TARGET_UBOOT_CUSTOM_TARBALL_LOCATION="$(call github,OpenNuvoton,NUC970_U-Boot_v2016.11,master)/NUC970_U-Boot_v2016.11-master.tar.gz"
BR2_TARGET_UBOOT_BOARD_DEFCONFIG="nuc980_iot"
BR2_PACKAGE_HOST_ENVIRONMENT_SETUP=y
```
